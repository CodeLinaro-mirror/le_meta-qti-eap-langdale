## conf/machine/imx6qsabrelite.conf
```bitbake
require ${WORKSPACE}/sources/meta-freescale-3rdparty/conf/machine/imx6qsabrelite.conf
require conf/machine/include/external-ap.inc

BBMASK += "meta-boundary/recipes-kernel/linux/linux-boundary_%.bbappend"

TARGET = "eap-imx"
```

## conf/machine/imx6sxsabresd.conf
```bitbake
require ${WORKSPACE}/sources/meta-freescale/conf/machine/imx6sxsabresd.conf
require conf/machine/include/external-ap.inc

IMX_DEFAULT_KERNEL_mx6 = "linux-imx"

TARGET = "eap-imx"

BBMASK .= "|meta-qti-eap/recipes-kernel/linux/linux-imx_4.9.88.bbappend"
BBMASK .= "|meta-qti-eap/recipes-kernel/linux/linux-imx_4.14.62.bbappend"
```

## conf/machine/include/external-ap.inc
```bitbake
# External AP add-on for non-QTI hosts

require ${COREBASE}/meta/conf/distro/include/security_flags.inc

MACHINE_FEATURES += "external-ap"
MACHINE_FEATURES += "wwan-plus-cv2x"
MACHINE_FEATURES += "diag"
MACHINE_FEATURES += "qti-location"

DISTRO_FEATURES:remove = "sysvinit"

# Use systemd init manager.
DISTRO_FEATURES:append = " systemd"
DISTRO_FEATURES_BACKFILL_CONSIDERED += "sysvinit"
VIRTUAL-RUNTIME_dev_manager = "udev"
VIRTUAL-RUNTIME_init_manager = "systemd"

# Change Image features for systemd.
IMAGE_DEV_MANAGER = "udev"
IMAGE_INIT_MANAGER = "systemd"
IMAGE_INITSCRIPTS = ""

# Add QTI users and groups
USERADDEXTENSION = "eap-qpermissions"
```

## conf/machine/include/sa2150p-eap.inc
```bitbake
# External AP add-on to SA2150P

MACHINE_FEATURES += "external-ap"
MACHINE_FEATURES += "wwan-plus-cv2x"
MACHINE_FEATURES += "diag"
MACHINE_FEATURES += "pps"
MACHINE_FEATURES += "qcmap"

BBMASK += "meta-qti-bsp/recipes-devtools/nanopb-c/nanopb_0.3.8.bb"
BBMASK += "meta-qti-bsp/recipes-devtools/python/python-protobuf_3.3.0.bb"
BBMASK += "meta-qti-bsp/recipes-devtools/protobuf/protobuf_3.3.0.bb"
BBMASK += "meta-qti-data/recipes/data/data_git.bbappend"
BBMASK += "meta-qti-data/recipes/data-oss/data-oss_git.bb"
BBMASK += "meta-qti-eap/recipes-kernel/linux/linux-imx_4.9.11.bb"
BBMASK += "meta-qti-eap/recipes-kernel/linux/linux-yocto_%.bbappend"
BBMASK += "meta-qti-eap/recipes-core/base-passwd/base-passwd_3.5.29.bbappend"
```
